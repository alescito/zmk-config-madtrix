## config/boards/shields/madtrix/Kconfig.defconfig
```kconfig
if SHIELD_MADTRIX_RIGHT

config ZMK_KEYBOARD_NAME
    default "Madtrix"

config ZMK_SPLIT_ROLE_CENTRAL
    default n

endif

if SHIELD_MADTRIX_LEFT || SHIELD_MADTRIX_RIGHT

config ZMK_SPLIT
    default y

endif
```

## config/west.yml
```yaml
manifest:
  remotes:
    - name: zmkfirmware
      url-base: https://github.com/alescito
  projects:
    - name: zmk 
      remote: alescito
      revision: main
      import: app/west.yml
  self:
    path: config
```
